## CMakeLists.txt
```
# SPDX-License-Identifier: Apache-2.0
# == DO NOT EDIT THE FOLLOWING LINES for the Raspberry Pi Pico VS Code Extension to work ==
# pico_zephyr
# =========================================================================================

cmake_minimum_required(VERSION 3.20.0)

find_package(Zephyr REQUIRED HINTS $ENV{ZEPHYR_BASE})
project(wifi)

FILE(GLOB app_sources src/*.c)
target_sources(app PRIVATE ${app_sources})
```

## prj.conf
```kconfig
CONFIG_NETWORKING=y
CONFIG_TEST_RANDOM_GENERATOR=y

CONFIG_MAIN_STACK_SIZE=5200
CONFIG_SHELL_STACK_SIZE=5200
CONFIG_NET_TX_STACK_SIZE=2048
CONFIG_NET_RX_STACK_SIZE=2048
CONFIG_LOG_BUFFER_SIZE=4096

CONFIG_NET_PKT_RX_COUNT=10
CONFIG_NET_PKT_TX_COUNT=10
CONFIG_NET_BUF_RX_COUNT=20
CONFIG_NET_BUF_TX_COUNT=20
CONFIG_NET_MAX_CONN=10
CONFIG_NET_MAX_CONTEXTS=10
CONFIG_NET_DHCPV4=y

CONFIG_NET_IPV4=y
CONFIG_NET_IPV6=n

CONFIG_NET_TCP=y
CONFIG_NET_SOCKETS=y

CONFIG_DNS_RESOLVER=y
CONFIG_DNS_SERVER_IP_ADDRESSES=y
CONFIG_DNS_SERVER1="192.0.2.2"
CONFIG_DNS_RESOLVER_AI_MAX_ENTRIES=10

# Network address config
CONFIG_NET_CONFIG_AUTO_INIT=n
CONFIG_NET_CONFIG_SETTINGS=y
CONFIG_NET_CONFIG_NEED_IPV4=y
CONFIG_NET_CONFIG_MY_IPV4_ADDR="192.0.2.1"
CONFIG_NET_CONFIG_PEER_IPV4_ADDR="192.0.2.2"
CONFIG_NET_CONFIG_MY_IPV4_GW="192.0.2.2"

CONFIG_NET_LOG=y
CONFIG_INIT_STACKS=y

CONFIG_NET_STATISTICS=y
CONFIG_NET_STATISTICS_PERIODIC_OUTPUT=n

CONFIG_HTTP_CLIENT=y

CONFIG_WIFI=y
CONFIG_WIFI_LOG_LEVEL_ERR=y
# printing of scan results puts pressure on queues in new locking
# design in net_mgmt. So, use a higher timeout for a crowded
# environment.
CONFIG_NET_MGMT_EVENT_QUEUE_TIMEOUT=5000
CONFIG_NET_MGMT_EVENT_QUEUE_SIZE=16

CONFIG_POSIX_API=y

CONFIG_JSON_LIBRARY=y

CONFIG_LOG=y

CONFIG_DEBUG=y
```

## src/main.c
```c
/*
 * SPDX-License-Identifier: Apache-2.0
 */

#include <zephyr/kernel.h>
#include <zephyr/logging/log.h>
#include <errno.h>

// Local includes
#include "http.h"
#include "json_definitions.h"
#include "ping.h"
#include "wifi.h"
#include "wifi_info.h"

LOG_MODULE_REGISTER(wifi_example);

/* HTTP server to connect to */
const char HTTP_HOSTNAME[] = "google.com";
const char HTTP_PATH[] = "/";
const char JSON_HOSTNAME[] = "jsonplaceholder.typicode.com";
const char JSON_GET_PATH[] = "/posts/1";
const char JSON_POST_PATH[] = "/posts";
const char json_post_payload[] = "{\"title\": \"RPi\", \"body\": \"Pico\", \"userId\": 199}";
struct placeholder_create_new_post new_post = {
	.title = "RPi",
	.body = "Pico",
	.userId = 199
};

int main(void)
{

	char json_payload_buffer[128];
	int encode_status = json_obj_encode_buf(
		placeholder_create_new_post_descr,
		ARRAY_SIZE(placeholder_create_new_post_descr),
		&new_post,
		json_payload_buffer,
		sizeof(json_payload_buffer)
	);
	if (encode_status < 0)
	{
		LOG_ERR("Error encoding JSON payload: %d", encode_status);
		return -1;
	}

	printk("Starting wifi example...\n");

	wifi_connect(WIFI_SSID, WIFI_PSK);

	// Ping Google DNS 4 times
	printk("Pinging 8.8.8.8 to demonstrate connection:\n");
    ping("8.8.8.8", 4);

	printk("Now performing http GET request to google.com...\n");

	http_get_example(HTTP_HOSTNAME, HTTP_PATH);
	k_sleep(K_SECONDS(1));

	struct placeholder_post get_post_result;
	
	int json_get_status = json_get_example(JSON_HOSTNAME, JSON_GET_PATH, &get_post_result);
	if (json_get_status < 0)
	{
		LOG_ERR("Error in json_get_example");
	} else {
		printk("Got JSON result:\n");
		printk("Title: %s\n", get_post_result.title);
		printk("Body: %s\n", get_post_result.body);
		printk("User ID: %d\n", get_post_result.id);
		printk("ID: %d\n", get_post_result.userId);
	}
	k_sleep(K_SECONDS(1));

	struct placeholder_post new_post_result;

	json_get_status = json_post_example(JSON_HOSTNAME, JSON_POST_PATH, &new_post, &new_post_result);
	if (json_get_status < 0)
	{
		LOG_ERR("Error in json_post_example");
	} else {
		printk("Got JSON result:\n");
		printk("Title: %s\n", new_post_result.title);
		printk("Body: %s\n", new_post_result.body);
		printk("User ID: %d\n", new_post_result.id);
		printk("ID: %d\n", new_post_result.userId);
	}
	k_sleep(K_SECONDS(1));

	return 0;
}
 
```

## src/http.c
```c
#include "http.h"

#include <zephyr/kernel.h>
#include <zephyr/data/json.h>
#include <zephyr/logging/log.h>
#include <zephyr/net/http/client.h>
#include <zephyr/net/net_config.h>
#include <zephyr/net/net_if.h>
#include <zephyr/net/net_ip.h>
#include <zephyr/net/socket.h>
#include <zephyr/net/wifi_mgmt.h>
#include <zephyr/posix/netdb.h>

#include "json_definitions.h"

LOG_MODULE_REGISTER(http);

#define HTTP_PORT "80"

static K_SEM_DEFINE(json_response_complete, 0, 1);
static K_SEM_DEFINE(http_response_complete, 0, 1);
static const char * json_post_headers[] = { "Content-Type: application/json\r\n", NULL };

// Holds the HTTP response
static char response_buffer[2048];

// Holds the JSON payload
char json_payload_buffer[128];

// Keeps track of JSON parsing result
static struct json_example_object * returned_placeholder_post = NULL;
static int json_parse_result = -1;

// void http_get(const char * hostname, const char * path);

int connect_socket(const char * hostname)
{
    static struct addrinfo hints;
	struct addrinfo *res;
	int st, sock;

	printk("Looking up IP addresses:\n");
    hints.ai_family = AF_UNSPEC;
	hints.ai_socktype = SOCK_STREAM;
	st = getaddrinfo(hostname, HTTP_PORT, &hints, &res);
	if (st != 0) {
		printk("Unable to resolve address, quitting\n");
		return -1;
	}
	printk("getaddrinfo status: %d\n", st);

	dump_addrinfo(res);

	sock = socket(res->ai_family, res->ai_socktype, res->ai_protocol);
	if (sock < 0)
	{
		printk("Issue setting up socket: %d\n", sock);
		return -1;
	}
	printk("sock = %d\n", sock);

	printk("Connecting to server...\n");
	int connect_result = connect(sock, res->ai_addr, res->ai_addrlen);
	if (connect_result != 0)
	{
		printk("Issue during connect: %d\n", sock);
		return -1;
	}

    return sock;
}

static void http_response_cb(struct http_response *rsp,
	enum http_final_call final_data,
	void *user_data)
{
	printk("HTTP Callback: %.*s", rsp->data_len, rsp->recv_buf);

	if (HTTP_DATA_FINAL == final_data){
		printk("\n");
		k_sem_give(&http_response_complete);
	}
}

void http_get_example(const char * hostname, const char * path)
{
	int sock = connect_socket(hostname);
	if (sock < 0)
	{
		printk("Issue setting up socket: %d\n", sock);
		return;
	}

	printk("Connected. Making HTTP request...\n");

	struct http_request req = { 0 };
	int ret;

	req.method = HTTP_GET;
	req.host = hostname;
	req.url = path;
	req.protocol = "HTTP/1.1";
	req.response = http_response_cb;
	req.recv_buf = response_buffer;
	req.recv_buf_len = sizeof(response_buffer);

	/* sock is a file descriptor referencing a socket that has been connected
	* to the HTTP server.
	*/
	ret = http_client_req(sock, &req, 5000, NULL);
	printk("HTTP Client Request returned: %d\n", ret);

	k_sem_take(&http_response_complete, K_FOREVER);

	printk("\nClose socket\n");

	(void)close(sock);
}

static void json_response_cb(struct http_response *rsp,
	enum http_final_call final_data,
	void *user_data)
{
	printk("JSON Callback: %.*s\n", rsp->data_len, rsp->recv_buf);

	if (rsp->body_found)
	{
		printk("Body:\n");
		printk("%.*s", rsp->body_frag_len, rsp->body_frag_start);

		if (returned_placeholder_post != NULL)
		{
			json_parse_result = json_obj_parse(
				rsp->body_frag_start,
				rsp->body_frag_len,
				json_example_object_descr,
				ARRAY_SIZE(json_example_object_descr),
				returned_placeholder_post
			);

			if (json_parse_result < 0)
			{
				LOG_ERR("JSON Parse Error: %d", json_parse_result);
			}
			else
			{
				LOG_DBG("json_obj_parse return code: %d", json_parse_result);
				LOG_DBG("Title: %s", returned_placeholder_post->title);
				LOG_DBG("Body: %s", returned_placeholder_post->body);
				LOG_DBG("User ID: %d", returned_placeholder_post->id);
				LOG_DBG("ID: %d", returned_placeholder_post->userId);
			}
		} else {
			LOG_ERR("No pointer passed to copy JSON GET result to");
		}
	}

	if (HTTP_DATA_FINAL == final_data){
		printk("\n");
		k_sem_give(&json_response_complete);
	}
}

int json_get_example(const char * hostname, const char * path, struct json_example_object * result)
{
	json_parse_result = -1;
	returned_placeholder_post = result;

	int sock = connect_socket(hostname);
	if (sock < 0)
	{
		printk("Issue setting up socket: %d\n", sock);
		return -1;
	}

	printk("Connected. Get JSON Payload...\n");

	struct http_request req = { 0 };
	int ret;

	req.method = HTTP_GET;
	req.host = hostname;
	req.url = path;
	req.protocol = "HTTP/1.1";
	req.response = json_response_cb;
	req.recv_buf = response_buffer;
	req.recv_buf_len = sizeof(response_buffer);

	/* sock is a file descriptor referencing a socket that has been connected
	* to the HTTP server.
	*/
	ret = http_client_req(sock, &req, 5000, NULL);
	printk("HTTP Client Request returned: %d\n", ret);
	if (ret < 0)
	{
		LOG_ERR("Error sending HTTP Client Request");
		return -1;
	}

	k_sem_take(&json_response_complete, K_FOREVER);

	printk("JSON Response complete\n");

	printk("Close socket\n");

	(void)close(sock);

	return json_parse_result;
}

int json_post_example(const char * hostname, const char * path, struct json_example_payload * payload, struct json_example_object * result)
{
	json_parse_result = -1;
	returned_placeholder_post = result;

    int sock = connect_socket(hostname);
	if (sock < 0)
	{
		printk("Issue setting up socket: %d\n", sock);
		return -1;
	}

	printk("Connected. Post JSON Payload...\n");

	// Parse the JSON object into a buffer
	int required_buffer_len = json_calc_encoded_len(
		json_example_payload_descr,
		ARRAY_SIZE(json_example_payload_descr),
		payload
	);
	if (required_buffer_len > sizeof(json_payload_buffer))
	{
		LOG_ERR("Payload is too large. Increase size of json_payload_buffer in http.c");
		return -1;
	}

	int encode_status = json_obj_encode_buf(
		json_example_payload_descr,
		ARRAY_SIZE(json_example_payload_descr),
		payload,
		json_payload_buffer,
		sizeof(json_payload_buffer)
	);
	if (encode_status < 0)
	{
		LOG_ERR("Error encoding JSON payload: %d", encode_status);
		return -1;
	}

	LOG_DBG("%s", json_payload_buffer);

    struct http_request req = { 0 };
	int ret;

	req.method = HTTP_POST;
	req.host = hostname;
	req.url = path;
	req.header_fields = json_post_headers;
	req.protocol = "HTTP/1.1";
	req.response = json_response_cb;
	req.payload = json_payload_buffer;
	req.payload_len = strlen(json_payload_buffer);
	req.recv_buf = response_buffer;
	req.recv_buf_len = sizeof(response_buffer);

	ret = http_client_req(sock, &req, 5000, NULL);
	printk("HTTP Client Request returned: %d\n", ret);

	k_sem_take(&json_response_complete, K_FOREVER);

	printk("JSON Response complete\n");

	printk("Close socket\n");

	(void)close(sock);

	return json_parse_result;
}

void dump_addrinfo(const struct addrinfo *ai)
{
	printk("addrinfo @%p: ai_family=%d, ai_socktype=%d, ai_protocol=%d, "
	       "sa_family=%d, sin_port=%x\n",
	       ai, ai->ai_family, ai->ai_socktype, ai->ai_protocol, ai->ai_addr->sa_family,
	       ntohs(((struct sockaddr_in *)ai->ai_addr)->sin_port));
}
```

## src/http.h
```c
#ifndef PICO_EXAMPLE_HTTP_H_
#define PICO_EXAMPLE_HTTP_H_

#include <zephyr/net/http/client.h>
#include <zephyr/posix/netdb.h>

#include "json_definitions.h"

void dump_addrinfo(const struct addrinfo *ai);

void http_get_example(const char * hostname, const char * path);

int json_get_example(const char * hostname, const char * path, struct placeholder_post * result);

int json_post_example(const char * hostname, const char * path, struct placeholder_create_new_post * payload, struct placeholder_post * result);

#endif // PICO_EXAMPLE_HTTP_H_
```

## src/json_definitions.h
```c
#ifndef PICO_EXAMPLE_JSON_DEFINITIONS_H_
#define PICO_EXAMPLE_JSON_DEFINITIONS_H_

#include <zephyr/data/json.h>

struct placeholder_post {
	const char *title;
	const char *body;
	int id;
	int userId;
};

static const struct json_obj_descr placeholder_post_descr[] = {
	JSON_OBJ_DESCR_PRIM(struct placeholder_post, title, JSON_TOK_STRING),
	JSON_OBJ_DESCR_PRIM(struct placeholder_post, body, JSON_TOK_STRING),
	JSON_OBJ_DESCR_PRIM(struct placeholder_post, id, JSON_TOK_NUMBER),
	JSON_OBJ_DESCR_PRIM(struct placeholder_post, userId, JSON_TOK_NUMBER),
};

struct placeholder_new_post {
	const char *title;
	const char *body;
    int userId;
};

static const struct json_obj_descr placeholder_create_new_post_descr[] = {
	JSON_OBJ_DESCR_PRIM(struct placeholder_new_post, title, JSON_TOK_STRING),
	JSON_OBJ_DESCR_PRIM(struct placeholder_new_post, body, JSON_TOK_STRING),
	JSON_OBJ_DESCR_PRIM(struct placeholder_new_post, userId, JSON_TOK_NUMBER),
};

#endif // PICO_JSON_DEFINITIONS_H_
```

## src/ping.c
```c
#include "ping.h"

#include <zephyr/kernel.h>
#include <zephyr/net/icmp.h>
#include <zephyr/net/socket.h>

int icmp_echo_reply_handler(struct net_icmp_ctx *ctx,
    struct net_pkt *pkt,
    struct net_icmp_ip_hdr *hdr,
    struct net_icmp_hdr *icmp_hdr,
    void *user_data)
{
    uint32_t cycles;
    char ipv4[INET_ADDRSTRLEN];
    zsock_inet_ntop(AF_INET, &hdr->ipv4->src, ipv4, INET_ADDRSTRLEN);

    uint32_t *start_cycles = user_data;

    cycles = k_cycle_get_32() - *start_cycles;

    printk("Reply from %s: bytes=%d time=%dms TTL=%d\r\n",
    ipv4,
    ntohs(hdr->ipv4->len),
    ((uint32_t)k_cyc_to_ns_floor64(cycles) / 1000000),
    hdr->ipv4->ttl);

    return 0;
}

void ping(char* ipv4_addr, uint8_t count)
{
    uint32_t cycles;
    int ret;
    struct net_icmp_ctx icmp_context;

    // Register handler for echo reply
    ret = net_icmp_init_ctx(&icmp_context, NET_ICMPV4_ECHO_REPLY, 0, icmp_echo_reply_handler);
    if (ret != 0) {
    printk("Failed to init ping, err: %d", ret);
    }

    struct net_if *iface = net_if_get_default();
    struct sockaddr_in dst_addr;
    net_addr_pton(AF_INET, ipv4_addr, &dst_addr.sin_addr);
    dst_addr.sin_family = AF_INET;

    for (int i = 0; i < count; i++)
    {
        cycles = k_cycle_get_32();
        ret = net_icmp_send_echo_request(&icmp_context, iface, (struct sockaddr *)&dst_addr, NULL, &cycles);
        if (ret != 0) {
        printk("Failed to send ping, err: %d", ret);
        }
        k_sleep(K_SECONDS(1));
    }

    net_icmp_cleanup_ctx(&icmp_context);
}
```

## src/wifi.c
```c
#include "wifi.h"

#include <zephyr/net/wifi_mgmt.h>

void wifi_connect(const char * ssid, const char * psk)
{
	struct net_if *iface = net_if_get_default();
	struct wifi_connect_req_params cnx_params = { 0 };

	cnx_params.ssid = ssid;
	cnx_params.ssid_length = strlen(cnx_params.ssid);
	cnx_params.psk = psk;
	cnx_params.psk_length = strlen(cnx_params.psk);
    cnx_params.security = WIFI_SECURITY_TYPE_NONE;
	cnx_params.band = WIFI_FREQ_BAND_UNKNOWN;
	cnx_params.channel = WIFI_CHANNEL_ANY;
	cnx_params.mfp = WIFI_MFP_OPTIONAL;
	cnx_params.wpa3_ent_mode = WIFI_WPA3_ENTERPRISE_NA;
	cnx_params.eap_ver = 1;
	cnx_params.bandwidth = WIFI_FREQ_BANDWIDTH_20MHZ;
	cnx_params.verify_peer_cert = false;

	int connection_result = 1;
	
	while (connection_result != 0){
		printk("Attempting to connect to network %s...\n", ssid);
		connection_result = net_mgmt(NET_REQUEST_WIFI_CONNECT, iface,
				&cnx_params, sizeof(struct wifi_connect_req_params));
		if (connection_result) {
			printk("Connection request failed with error: %d\n", connection_result);
		}
		k_sleep(K_MSEC(1000));
	}

	printk("Connection succeeded.\n");
}
```
